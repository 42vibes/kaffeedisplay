## firmware/components/board/Kconfig
```kconfig
menu "Board"

config BOARD_DISPLAY_SELFTEST
    bool "Run the RGB scanout colour self-test before LVGL"
    default n
    help
        Fill the ST7701S framebuffer directly with red, green, blue, white and
        eight vertical colour bars before LVGL starts. Intended for bring-up
        diagnostics only; the normal boot continues after the test when
        disabled.

endmenu
```

## firmware/sdkconfig.defaults
```kconfig
CONFIG_IDF_TARGET="esp32s3"

# Flash: 16 MB, quad, 80 MHz
CONFIG_ESPTOOLPY_FLASHSIZE_16MB=y
CONFIG_ESPTOOLPY_FLASHMODE_QIO=y
CONFIG_ESPTOOLPY_FLASHFREQ_80M=y
CONFIG_PARTITION_TABLE_CUSTOM=y
CONFIG_PARTITION_TABLE_CUSTOM_FILENAME="partitions.csv"
CONFIG_PARTITION_TABLE_FILENAME="partitions.csv"

# Octal PSRAM (ESP32-S3R8)
CONFIG_SPIRAM=y
CONFIG_SPIRAM_MODE_OCT=y
CONFIG_SPIRAM_SPEED_80M=y
CONFIG_SPIRAM_USE_MALLOC=y
CONFIG_SPIRAM_TRY_ALLOCATE_WIFI_LWIP=y

# Tasks and system
CONFIG_FREERTOS_HZ=1000
CONFIG_ESP_MAIN_TASK_STACK_SIZE=8192
CONFIG_ESP_SYSTEM_EVENT_TASK_STACK_SIZE=4096
CONFIG_ESP_TASK_WDT_TIMEOUT_S=20
CONFIG_ESP_TASK_WDT_CHECK_IDLE_TASK_CPU0=y
CONFIG_ESP_TASK_WDT_CHECK_IDLE_TASK_CPU1=y
CONFIG_COMPILER_CXX_EXCEPTIONS=y
CONFIG_COMPILER_CXX_RTTI=n

# Wi-Fi: AP+STA, no Bluetooth
CONFIG_BT_ENABLED=n
CONFIG_ESP_WIFI_SOFTAP_SUPPORT=y
CONFIG_ESP_WIFI_NVS_ENABLED=y
CONFIG_ESP_WIFI_11KV_SUPPORT=y

# HTTP / networking
CONFIG_LWIP_MAX_SOCKETS=12
CONFIG_HTTPD_MAX_REQ_HDR_LEN=4096
CONFIG_HTTPD_MAX_URI_LEN=1024
CONFIG_HTTPD_TASK_STACK_SIZE=8192
CONFIG_MDNS_MAX_SERVICES=4
CONFIG_MDNS_TASK_STACK_SIZE=4096

# OTA rollback
CONFIG_BOOTLOADER_APP_ROLLBACK_ENABLE=y

# LittleFS
CONFIG_LITTLEFS_MAX_PARTITIONS=1
CONFIG_LITTLEFS_PAGE_SIZE=256
CONFIG_LITTLEFS_OBJ_NAME_LEN=64

# LVGL defaults (components may override)
CONFIG_LV_COLOR_DEPTH_16=y
CONFIG_LV_USE_QRCODE=y

# Logs
CONFIG_LOG_DEFAULT_LEVEL_INFO=y
CONFIG_LOG_MAXIMUM_LEVEL_DEBUG=y

# Optional STA+AP NAPT (disabled by default in settings, enabled in the build)
CONFIG_LWIP_IP_FORWARD=y
CONFIG_LWIP_IPV4_NAPT=y
```
